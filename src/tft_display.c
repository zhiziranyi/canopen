#include "tft_display.h"
#include "cn_font.h"

/* SPI handle — must match reference's hspi3 usage */
SPI_HandleTypeDef hspi3;

/* ---- Pin definitions (same as reference) ---- */

#define LCD_SCK_PIN         GPIO_PIN_3
#define LCD_SCK_PORT        GPIOB
#define LCD_SDA_PIN         GPIO_PIN_5
#define LCD_SDA_PORT        GPIOB
#define LCD_CS_PIN          GPIO_PIN_11
#define LCD_CS_PORT         GPIOD
#define LCD_DC_PIN          GPIO_PIN_12
#define LCD_DC_PORT         GPIOD
#define LCD_BL_PIN          GPIO_PIN_13
#define LCD_BL_PORT         GPIOD

#define LCD_CS_H    (LCD_CS_PORT->BSRR = LCD_CS_PIN)
#define LCD_CS_L    (LCD_CS_PORT->BSRR = (uint32_t)LCD_CS_PIN << 16U)
#define LCD_DC_CMD  HAL_GPIO_WritePin(LCD_DC_PORT, LCD_DC_PIN, GPIO_PIN_RESET)
#define LCD_DC_DATA HAL_GPIO_WritePin(LCD_DC_PORT, LCD_DC_PIN, GPIO_PIN_SET)
#define LCD_BL_ON   HAL_GPIO_WritePin(LCD_BL_PORT, LCD_BL_PIN, GPIO_PIN_SET)
#define LCD_BL_OFF  HAL_GPIO_WritePin(LCD_BL_PORT, LCD_BL_PIN, GPIO_PIN_RESET)

/* ---- HAL_SPI_MspInit (exact copy from reference) ---- */

void HAL_SPI_MspInit(SPI_HandleTypeDef *hspi)
{
    GPIO_InitTypeDef GPIO_InitStruct = {0};
    if (hspi->Instance == SPI3) {
        __HAL_RCC_SPI3_CLK_ENABLE();
        __HAL_RCC_GPIOB_CLK_ENABLE();
        __HAL_RCC_GPIOD_CLK_ENABLE();

        GPIO_InitStruct.Pin       = LCD_SCK_PIN;
        GPIO_InitStruct.Mode      = GPIO_MODE_AF_PP;
        GPIO_InitStruct.Pull      = GPIO_NOPULL;
        GPIO_InitStruct.Speed     = GPIO_SPEED_FREQ_VERY_HIGH;
        GPIO_InitStruct.Alternate = GPIO_AF6_SPI3;
        HAL_GPIO_Init(LCD_SCK_PORT, &GPIO_InitStruct);

        GPIO_InitStruct.Pin = LCD_SDA_PIN;
        HAL_GPIO_Init(LCD_SDA_PORT, &GPIO_InitStruct);

        GPIO_InitStruct.Pin   = LCD_CS_PIN;
        GPIO_InitStruct.Mode  = GPIO_MODE_OUTPUT_PP;
        GPIO_InitStruct.Speed = GPIO_SPEED_FREQ_HIGH;
        HAL_GPIO_Init(LCD_CS_PORT, &GPIO_InitStruct);

        GPIO_InitStruct.Pin   = LCD_BL_PIN;
        GPIO_InitStruct.Speed = GPIO_SPEED_FREQ_LOW;
        HAL_GPIO_Init(LCD_BL_PORT, &GPIO_InitStruct);

        GPIO_InitStruct.Pin   = LCD_DC_PIN;
        GPIO_InitStruct.Speed = GPIO_SPEED_FREQ_HIGH;
        HAL_GPIO_Init(LCD_DC_PORT, &GPIO_InitStruct);

        LCD_DC_DATA;
        LCD_CS_H;
        LCD_BL_OFF;
    }
}

/* ---- MX_SPI3_Init (exact copy from reference) ---- */

static void MX_SPI3_Init(void)
{
    hspi3.Instance               = SPI3;
    hspi3.Init.Mode              = SPI_MODE_MASTER;
    hspi3.Init.Direction         = SPI_DIRECTION_1LINE;
    hspi3.Init.DataSize          = SPI_DATASIZE_8BIT;
    hspi3.Init.CLKPolarity       = SPI_POLARITY_LOW;
    hspi3.Init.CLKPhase          = SPI_PHASE_1EDGE;
    hspi3.Init.NSS               = SPI_NSS_SOFT;
    hspi3.Init.BaudRatePrescaler = SPI_BAUDRATEPRESCALER_2;
    hspi3.Init.FirstBit          = SPI_FIRSTBIT_MSB;
    hspi3.Init.TIMode            = SPI_TIMODE_DISABLE;
    hspi3.Init.CRCCalculation    = SPI_CRCCALCULATION_DISABLE;
    HAL_SPI_Init(&hspi3);
    __HAL_SPI_ENABLE(&hspi3);
    SPI_1LINE_TX(&hspi3);
}

/* ---- LCD write functions (exact copy from reference) ---- */

static void LCD_WriteCommand(uint8_t cmd)
{
    while ((hspi3.Instance->SR & SPI_SR_BSY));
    LCD_DC_CMD;
    hspi3.Instance->DR = cmd;
    while (!(hspi3.Instance->SR & SPI_SR_TXE));
    while ((hspi3.Instance->SR & SPI_SR_BSY));
    LCD_DC_DATA;
}

static void LCD_WriteData8(uint8_t data)
{
    hspi3.Instance->DR = data;
    while (!(hspi3.Instance->SR & SPI_SR_TXE));
}

static void LCD_WriteData16(uint16_t data)
{
    hspi3.Instance->DR = (uint8_t)(data >> 8);
    while (!(hspi3.Instance->SR & SPI_SR_TXE));
    hspi3.Instance->DR = (uint8_t)(data & 0xFF);
    while (!(hspi3.Instance->SR & SPI_SR_TXE));
}

/* ---- SPI_LCD_Init (exact copy from reference, stripped of fonts/graphics) ---- */

void TFT_Init(void)
{
    MX_SPI3_Init();
    HAL_Delay(10);

    LCD_CS_L;

    LCD_WriteCommand(0x36);
    LCD_WriteData8(0x00);

    LCD_WriteCommand(0x3A);
    LCD_WriteData8(0x05);

    LCD_WriteCommand(0xB2);
    LCD_WriteData8(0x0C); LCD_WriteData8(0x0C); LCD_WriteData8(0x00);
    LCD_WriteData8(0x33); LCD_WriteData8(0x33);

    LCD_WriteCommand(0xB7);
    LCD_WriteData8(0x35);

    LCD_WriteCommand(0xBB);
    LCD_WriteData8(0x19);

    LCD_WriteCommand(0xC0);
    LCD_WriteData8(0x2C);

    LCD_WriteCommand(0xC2);
    LCD_WriteData8(0x01);

    LCD_WriteCommand(0xC3);
    LCD_WriteData8(0x12);

    LCD_WriteCommand(0xC4);
    LCD_WriteData8(0x20);

    LCD_WriteCommand(0xC6);
    LCD_WriteData8(0x0F);

    LCD_WriteCommand(0xD0);
    LCD_WriteData8(0xA4); LCD_WriteData8(0xA1);

    LCD_WriteCommand(0xE0);
    LCD_WriteData8(0xD0); LCD_WriteData8(0x04); LCD_WriteData8(0x0D);
    LCD_WriteData8(0x11); LCD_WriteData8(0x13); LCD_WriteData8(0x2B);
    LCD_WriteData8(0x3F); LCD_WriteData8(0x54); LCD_WriteData8(0x4C);
    LCD_WriteData8(0x18); LCD_WriteData8(0x0D); LCD_WriteData8(0x0B);
    LCD_WriteData8(0x1F); LCD_WriteData8(0x23);

    LCD_WriteCommand(0xE1);
    LCD_WriteData8(0xD0); LCD_WriteData8(0x04); LCD_WriteData8(0x0C);
    LCD_WriteData8(0x11); LCD_WriteData8(0x13); LCD_WriteData8(0x2C);
    LCD_WriteData8(0x3F); LCD_WriteData8(0x44); LCD_WriteData8(0x51);
    LCD_WriteData8(0x2F); LCD_WriteData8(0x1F); LCD_WriteData8(0x1F);
    LCD_WriteData8(0x20); LCD_WriteData8(0x23);

    LCD_WriteCommand(0x21);

    LCD_WriteCommand(0x11);
    HAL_Delay(120);

    LCD_WriteCommand(0x29);

    while ((hspi3.Instance->SR & SPI_SR_BSY));
    LCD_CS_H;

    LCD_BL_ON;
}

/* ---- Public API wrappers ---- */

void TFT_SetBacklight(uint8_t brightness)
{
    if (brightness) LCD_BL_ON; else LCD_BL_OFF;
}

static void LCD_SetAddress(uint16_t x1, uint16_t y1, uint16_t x2, uint16_t y2)
{
    LCD_CS_L;
    LCD_WriteCommand(0x2A);
    LCD_WriteData16(x1);
    LCD_WriteData16(x2);
    LCD_WriteCommand(0x2B);
    LCD_WriteData16(y1);
    LCD_WriteData16(y2);
    LCD_WriteCommand(0x2C);
    while (hspi3.Instance->SR & SPI_SR_BSY);
    LCD_CS_H;
}

void TFT_SetAddrWindow(uint16_t x0, uint16_t y0, uint16_t x1, uint16_t y1)
{
    LCD_SetAddress(x0, y0, x1, y1);
}

static void LCD_Clear(uint16_t color)
{
    uint32_t i, n = 240U * 240U;

    LCD_CS_L;
    LCD_WriteCommand(0x2A);
    LCD_WriteData16(0x0000);
    LCD_WriteData16(0x00EF);  /* 239 */
    LCD_WriteCommand(0x2B);
    LCD_WriteData16(0x0000);
    LCD_WriteData16(0x00EF);  /* 239 */
    LCD_WriteCommand(0x2C);

    CLEAR_BIT(hspi3.Instance->CR1, SPI_CR1_SPE);
    SET_BIT(hspi3.Instance->CR1, SPI_CR1_DFF);
    SET_BIT(hspi3.Instance->CR1, SPI_CR1_SPE);

    for (i = 0; i < n; i++) {
        hspi3.Instance->DR = color;
        while (!(hspi3.Instance->SR & SPI_SR_TXE));
    }
    while (hspi3.Instance->SR & SPI_SR_BSY);
    LCD_CS_H;

    CLEAR_BIT(hspi3.Instance->CR1, SPI_CR1_SPE);
    CLEAR_BIT(hspi3.Instance->CR1, SPI_CR1_DFF);
    SET_BIT(hspi3.Instance->CR1, SPI_CR1_SPE);
}

void TFT_FillScreen(uint16_t color)
{
    LCD_Clear(color);
}

void TFT_PushColors(uint16_t *colors, uint32_t count)
{
    uint32_t i;

    CLEAR_BIT(hspi3.Instance->CR1, SPI_CR1_SPE);
    SET_BIT(hspi3.Instance->CR1, SPI_CR1_DFF);
    SET_BIT(hspi3.Instance->CR1, SPI_CR1_SPE);

    LCD_CS_L;
    for (i = 0; i < count; i++) {
        hspi3.Instance->DR = colors[i];
        while (!(hspi3.Instance->SR & SPI_SR_TXE));
    }
    while (hspi3.Instance->SR & SPI_SR_BSY);
    LCD_CS_H;

    CLEAR_BIT(hspi3.Instance->CR1, SPI_CR1_SPE);
    CLEAR_BIT(hspi3.Instance->CR1, SPI_CR1_DFF);
    SET_BIT(hspi3.Instance->CR1, SPI_CR1_SPE);
}

/* ---- Video frame streaming (fast, single SPI mode switch) ---- */

void TFT_StreamStart(void)
{
    LCD_CS_L;
    LCD_WriteCommand(0x2A); LCD_WriteData16(0x0000); LCD_WriteData16(0x00EF);
    LCD_WriteCommand(0x2B); LCD_WriteData16(0x0000); LCD_WriteData16(0x00EF);
    LCD_WriteCommand(0x2C);
    while (hspi3.Instance->SR & SPI_SR_BSY);

    CLEAR_BIT(hspi3.Instance->CR1, SPI_CR1_SPE);
    SET_BIT(hspi3.Instance->CR1, SPI_CR1_DFF);
    SET_BIT(hspi3.Instance->CR1, SPI_CR1_SPE);
}

void TFT_StreamPush(uint16_t *data, uint32_t count)
{
    for (uint32_t i = 0; i < count; i++) {
        hspi3.Instance->DR = data[i];
        while (!(hspi3.Instance->SR & SPI_SR_TXE));
    }
}

void TFT_StreamEnd(void)
{
    while (hspi3.Instance->SR & SPI_SR_BSY);
    LCD_CS_H;
    CLEAR_BIT(hspi3.Instance->CR1, SPI_CR1_SPE);
    CLEAR_BIT(hspi3.Instance->CR1, SPI_CR1_DFF);
    SET_BIT(hspi3.Instance->CR1, SPI_CR1_SPE);
}

/* ---- ASCII 8x16 font data (95 chars, space through ~) ---- */

static const uint8_t ASCII_1608_Table[] = {
    0x00,0x00,0x00,0x00,0x00,0x00,0x00,0x00,0x00,0x00,0x00,0x00,0x00,0x00,0x00,0x00,/*" ",0*/
    0x00,0x00,0x00,0x08,0x08,0x08,0x08,0x08,0x08,0x08,0x00,0x00,0x18,0x18,0x00,0x00,/*"!",1*/
    0x00,0x48,0x6C,0x24,0x12,0x00,0x00,0x00,0x00,0x00,0x00,0x00,0x00,0x00,0x00,0x00,/*""",2*/
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    0x0C,0x32,0xC2,0x00,0x00,0x00,0x00,0x00,0x00,0x00,0x00,0x00,0x00,0x00,0x00,0x00,/*"~",94*/
};

static uint16_t g_text_fg = COLOR_WHITE;
static uint16_t g_text_bg = COLOR_BLACK;

/* One-character render buffer (max 32x32 from reference) */
static uint16_t g_char_buf[32 * 32];

void TFT_SetTextColor(uint16_t fg, uint16_t bg)
{
    g_text_fg = fg;
    g_text_bg = bg;
}

void TFT_DrawChar(uint16_t x, uint16_t y, char c)
{
    uint16_t i = 0, row, col;
    unsigned char idx;

    if (c < 32 || c > 126) c = ' ';
    idx = (unsigned char)(c - 32);

    /* Font data is row-major: each byte = one row of 8 pixels, LSB=leftmost */
    for (row = 0; row < FONT_H; row++) {
        unsigned char data = ASCII_1608_Table[idx * FONT_H + row];
        for (col = 0; col < FONT_W; col++) {
            g_char_buf[i++] = (data & 0x01) ? g_text_fg : g_text_bg;
            data >>= 1;
        }
    }

    TFT_SetAddrWindow(x, y, x + FONT_W - 1, y + FONT_H - 1);
    TFT_PushColors(g_char_buf, FONT_W * FONT_H);
}

void TFT_DrawString(uint16_t x, uint16_t y, const char *str)
{
    while (*str && x < TFT_WIDTH) {
        if (*str == '\n') {
            x = 0;
            y += FONT_H;
            str++;
            continue;
        }
        TFT_DrawChar(x, y, *str);
        x += FONT_W;
        str++;
    }
}

/* Draw a 16x16 Chinese glyph (font is column-major, TFT expects row-major) */
void TFT_DrawChar16(uint16_t x, uint16_t y, const uint8_t *bmp)
{
    for (int row = 0; row < 16; row++) {
        for (int col = 0; col < 16; col++) {
            int byte_ofs = col * 2 + row / 8;
            int bit = row % 8;
            uint8_t on = (bmp[byte_ofs] >> bit) & 1;
            g_char_buf[row * 16 + col] = on ? g_text_fg : g_text_bg;
        }
    }
    TFT_SetAddrWindow(x, y, x + 15, y + 15);
    TFT_PushColors(g_char_buf, 256);
}

/* UTF-8 text renderer: ASCII 8x16, Chinese 16x16, wraps at TFT_WIDTH */
void TFT_DrawUTF8(uint16_t x0, uint16_t y0, const uint8_t *data, unsigned int len)
{
    uint16_t x = x0, y = y0;
    unsigned int pos = 0;

    while (pos < len && y + 16 <= TFT_HEIGHT) {
        uint8_t c = data[pos];
        uint32_t cp;

        /* Decode UTF-8 */
        if (c < 0x80) { cp = c; pos++; }
        else if ((c & 0xE0) == 0xC0 && pos + 1 < len) {
            cp = ((c & 0x1F) << 6) | (data[pos + 1] & 0x3F);
            pos += 2;
        }
        else if ((c & 0xF0) == 0xE0 && pos + 2 < len) {
            cp = ((c & 0x0F) << 12) | ((data[pos + 1] & 0x3F) << 6) | (data[pos + 2] & 0x3F);
            pos += 3;
        }
        else { pos++; cp = 0xFFFD; } /* skip invalid byte */

        /* Handle newline */
        if (cp == '\n') { x = x0; y += 16; continue; }
        if (cp == '\r') continue;

        if (cp < 0x80) {
            /* ASCII: 8px wide */
            if (x + 8 > TFT_WIDTH) { x = x0; y += 16; }
            if (y + 16 > TFT_HEIGHT) break;
            TFT_DrawChar(x, y, (char)cp);
            x += 8;
        } else {
            /* Chinese/CJK: 16px wide */
            if (x + 16 > TFT_WIDTH) { x = x0; y += 16; }
            if (y + 16 > TFT_HEIGHT) break;
            const uint8_t *bmp = cn_font_lookup((uint16_t)cp);
            if (bmp) {
                TFT_DrawChar16(x, y, bmp);
            }
            x += 16;
        }
    }
}
